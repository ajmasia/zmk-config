#include <dt-bindings/led/led.h>

&pwm0 {
    status = "okay";
    ch0-pin = <45>; /* LED 0 */
    ch1-pin = <46>; /* LED 1 */
    ch2-pin = <47>; /* LED 2 */
};

/ {
    chosen {
        zmk,backlight = &backlight;
    };
}:
